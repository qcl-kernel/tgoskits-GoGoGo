## os/axvisor/guests/task3/buildroot/package/task3-linux/Config.in
```kconfig
config BR2_PACKAGE_TASK3_LINUX
	bool "task3-linux"
	depends on BR2_aarch64
	help
	  Deterministic int8 CNN and RT-IPC line-control experiment client.
```

## os/axvisor/guests/task3/configs/buildroot_defconfig
```kconfig
BR2_aarch64=y
BR2_cortex_a53=y
BR2_TOOLCHAIN_BUILDROOT_MUSL=y
BR2_KERNEL_HEADERS_AS_KERNEL=y
BR2_PACKAGE_HOST_LINUX_HEADERS_CUSTOM_6_12=y
BR2_TARGET_GENERIC_HOSTNAME="task3-linux"
BR2_TARGET_GENERIC_ISSUE="Task3 Linux"
BR2_INIT_BUSYBOX=y
BR2_SYSTEM_DHCP=""
BR2_LINUX_KERNEL=y
BR2_LINUX_KERNEL_CUSTOM_VERSION=y
BR2_LINUX_KERNEL_CUSTOM_VERSION_VALUE="6.12.21"
BR2_LINUX_KERNEL_USE_CUSTOM_CONFIG=y
BR2_LINUX_KERNEL_CUSTOM_CONFIG_FILE="$(BR2_EXTERNAL_TASK3_PATH)/../configs/linux.config"
BR2_LINUX_KERNEL_NEEDS_HOST_OPENSSL=y
BR2_TARGET_ROOTFS_CPIO=y
BR2_ROOTFS_OVERLAY="$(BR2_EXTERNAL_TASK3_PATH)/rootfs-overlay"
BR2_PACKAGE_TASK3_LINUX=y
```

## os/axvisor/guests/zephyr-task123/boards/arm64/axvisor_rock4d/Kconfig.defconfig
```kconfig
if BOARD_AXVISOR_ROCK4D

config BUILD_OUTPUT_BIN
	default y

config MAX_THREAD_BYTES
	default 3

endif
```

## os/axvisor/guests/zephyr-task123/boards/arm64/axvisor_rock4d/axvisor_rock4d_defconfig
```kconfig
CONFIG_ARM_ARCH_TIMER=y
CONFIG_CACHE_MANAGEMENT=y
CONFIG_SERIAL=y
CONFIG_CONSOLE=y
CONFIG_UART_CONSOLE=y
CONFIG_UART_INTERRUPT_DRIVEN=y
CONFIG_ARMV8_A_NS=y
```

## os/axvisor/guests/zephyr-task123/boards/arm64/axvisor_rock4d/board.yml
```yaml
board:
  name: axvisor_rock4d
  full_name: AxVisor ROCK 4D guest
  vendor: axvisor
  socs:
    - name: qemu_cortex_a53
```
